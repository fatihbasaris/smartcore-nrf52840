## CMakeLists.txt
```
cmake_minimum_required(VERSION 3.20.0)
find_package(Zephyr REQUIRED HINTS $ENV{ZEPHYR_BASE})

project(fth_bt_gatt_1)

target_sources(app PRIVATE src/main.c)
```

## prj.conf
```kconfig
CONFIG_GPIO=y

CONFIG_SERIAL=y
CONFIG_CONSOLE=y
CONFIG_UART_CONSOLE=y

CONFIG_USB_DEVICE_STACK=y
CONFIG_USB_CDC_ACM=y
CONFIG_USB_DEVICE_INITIALIZE_AT_BOOT=y

CONFIG_CLOCK_CONTROL_NRF_K32SRC_RC=y
CONFIG_CLOCK_CONTROL_NRF_K32SRC_XTAL=n

CONFIG_BT=y
CONFIG_BT_PERIPHERAL=y
CONFIG_BT_DEVICE_NAME="E73_TEST"
```

## src/main.c
```c
#include <zephyr/kernel.h>
#include <zephyr/drivers/gpio.h>
#include <zephyr/sys/printk.h>
#include <zephyr/bluetooth/bluetooth.h>

static const struct gpio_dt_spec led =
    GPIO_DT_SPEC_GET(DT_ALIAS(led0), gpios);

static const struct bt_data ad[] = {
    BT_DATA_BYTES(BT_DATA_FLAGS,
                  BT_LE_AD_GENERAL | BT_LE_AD_NO_BREDR),

    BT_DATA(BT_DATA_NAME_COMPLETE,
            CONFIG_BT_DEVICE_NAME,
            sizeof(CONFIG_BT_DEVICE_NAME) - 1),
};

int main(void)
{
    int err;
    bool led_state = false;

    printk("Step 1: LED blink + USB printk\r\n");

    if (!device_is_ready(led.port)) {
        printk("LED device not ready\r\n");
        return 0;
    }

    err = gpio_pin_configure_dt(&led, GPIO_OUTPUT_INACTIVE);
    if (err < 0) {
        printk("LED config failed: %d\r\n", err);
        return 0;
    }

    err = bt_enable(NULL);
if (err) {
    printk("Bluetooth init failed: %d\r\n", err);
    return 0;
}

printk("Bluetooth initialized\r\n");

err = bt_le_adv_start(BT_LE_ADV_CONN_NAME,
                      ad,
                      ARRAY_SIZE(ad),
                      NULL,
                      0);

if (err) {
    printk("Advertising failed: %d\r\n", err);
    return 0;
}

printk("Advertising started: %s\r\n",
       CONFIG_BT_DEVICE_NAME);

    while (1) {
        led_state = !led_state;
        gpio_pin_set_dt(&led, led_state);

        if (led_state) {
            printk("LED ON\r\n");
        } else {
            printk("LED OFF\r\n");
        }

        k_sleep(K_SECONDS(1));
    }
}
```
