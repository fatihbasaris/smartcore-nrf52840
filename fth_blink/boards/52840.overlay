/ {
    
    leds {
        compatible = "gpio-leds";

        led0: led_0 {
            gpios = <&gpio0 30 GPIO_ACTIVE_HIGH>;
            label = "External LED";
        };
    };

    aliases {
        led0 = &led0;
    };
};